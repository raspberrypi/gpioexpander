## gpioexpand/Config.in
```kconfig
source "$BR2_EXTERNAL_GPIOEXPAND_PATH/package/pigpio/Config.in"
source "$BR2_EXTERNAL_GPIOEXPAND_PATH/package/rpi-firmware-custom/Config.in"
```

## gpioexpand/configs/gpioexpand_defconfig
```kconfig
BR2_arm=y
BR2_arm1176jzf_s=y
BR2_KERNEL_HEADERS_4_8=y
# BR2_UCLIBC_INSTALL_UTILS is not set
BR2_TARGET_GENERIC_HOSTNAME="extzero"
BR2_TARGET_GENERIC_ROOT_PASSWD="raspberry"
BR2_TARGET_GENERIC_GETTY_PORT="ttyGS0"
BR2_TARGET_GENERIC_GETTY_BAUDRATE_115200=y
BR2_ROOTFS_OVERLAY="$(BR2_EXTERNAL_GPIOEXPAND_PATH)/board/overlay/"
BR2_LINUX_KERNEL=y
BR2_LINUX_KERNEL_CUSTOM_GIT=y
BR2_LINUX_KERNEL_CUSTOM_REPO_URL="https://github.com/raspberrypi/linux.git"
BR2_LINUX_KERNEL_CUSTOM_REPO_VERSION="rpi-4.4.y"
BR2_LINUX_KERNEL_USE_CUSTOM_CONFIG=y
BR2_LINUX_KERNEL_CUSTOM_CONFIG_FILE="$(BR2_EXTERNAL_GPIOEXPAND_PATH)/board/kernelconfig-recovery.armv6"
BR2_LINUX_KERNEL_CONFIG_FRAGMENT_FILES="$(BR2_EXTERNAL_GPIOEXPAND_PATH)/board/kernelconfig-gpioexpand.fragment"
BR2_LINUX_KERNEL_DTS_SUPPORT=y
BR2_LINUX_KERNEL_INTREE_DTS_NAME="bcm2708-rpi-b-plus bcm2708-rpi-0-w overlays/dwc2-overlay"
BR2_PACKAGE_PIGPIO=y
BR2_PACKAGE_RPI_FIRMWARE_CUSTOM=y
BR2_PACKAGE_RPI_FIRMWARE_CUSTOM_INSTALL_DTBS=n
BR2_PACKAGE_RPI_FIRMWARE_CUSTOM_INSTALL_DTB_OVERLAYS=n
BR2_TARGET_ROOTFS_CPIO=y
BR2_TARGET_ROOTFS_CPIO_GZIP=y
# BR2_TARGET_ROOTFS_TAR is not set
```

## gpioexpand/package/pigpio/Config.in
```kconfig
config BR2_PACKAGE_PIGPIO
    bool "pigpio"
        help
          pigpio is a C library for the Raspberry which allows control of the General Purpose Input Outputs (GPIO).
          
          http://abyz.co.uk/rpi/pigpio/
```
